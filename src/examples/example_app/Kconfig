## src/examples/example_app/Kconfig
```kconfig
menuconfig EXAMPLES_EXAMPLE_APP
	bool "example_app"
	default n
	---help---
		Enable support for fake_imu
```

## src/modules/safe_land_provider/Kconfig
```kconfig
menuconfig MODULES_SAFE_LAND_PROVIDER
	bool "safe_land_provider"
	default n
	---help---
		Enable support for safe_land_provider
```
